## conf/layer.conf
```bitbake
# We have a conf and classes directory, add to BBPATH
BBPATH .= ":${LAYERDIR}"

# We have recipes-* directories, add to BBFILES
BBFILES += "${LAYERDIR}/recipes-*/*/*.bb \
	${LAYERDIR}/recipes-*/*/*.bbappend"

BBFILE_COLLECTIONS += "hosted-mender-login"
BBFILE_PATTERN_hosted-mender-login = "^${LAYERDIR}/"
BBFILE_PRIORITY_hosted-mender-login = "6"

IMAGE_INSTALL_append = " hosted-mender-login"
IMAGE_OVERHEAD_FACTOR ?= "1.0"

LAYERDEPENDS_hosted-mender-login = "qt5-layer"
```
